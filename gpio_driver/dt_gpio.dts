/dts-v1/;
/plugin/;

/ {
    compatible = "brcm,bcm2835";

    fragment@0 {
        target-path = "/";
        __overlay__ {
            my_device{
                compatible = "gpio,los-debugueadores";
                status = "okay";
                entrada-gpios = <&gpio 4 0>, <&gpio 17 0>;
            };
        };
    };
};